#include "corne.dtsi"

&kscan0 {
    col-gpios = <&pro_micro 017 GPIO_ACTIVE_HIGH>,
                <&pro_micro 011 GPIO_ACTIVE_HIGH>,
                <&pro_micro 100 GPIO_ACTIVE_HIGH>,
                <&pro_micro 024 GPIO_ACTIVE_HIGH>,
                <&pro_micro 022 GPIO_ACTIVE_HIGH>,
                <&pro_micro 020 GPIO_ACTIVE_HIGH>;
    row-gpios = <&pro_micro 031 (GPIO_ACTIVE_HIGH | GPIO_PULL_DOWN)>,
                <&pro_micro 002 (GPIO_ACTIVE_HIGH | GPIO_PULL_DOWN)>,
                <&pro_micro 029 (GPIO_ACTIVE_HIGH | GPIO_PULL_DOWN)>,
                <&pro_micro 115 (GPIO_ACTIVE_HIGH | GPIO_PULL_DOWN)>;
};

